/* naka_perf_style_link.ld — Linker script for naka_perf_style.c
 * Auto-generated by scripts/naka_struct_decode.py
 */

ENTRY(0)

SECTIONS {
    .text : { *(.text*) *(.rodata*) }
    /DISCARD/ : { *(.comment) *(.note*) *(.eh_frame*) }
}

ExtData_ChordTypeTable_Top = 0x00ED0008;
LABEL_E30006 = 0x00E30006;
NakaInst_176 = 0x00EC0098;
NakaInst_176_EC00C0 = 0x00EC00C0;
NakaInst_NEXT = 0x00EE00C3;
NakaInst_Param_EndFF = 0x00EE013B;
NakaInst_Param_Repeat = 0x00EE009B;
Naka_PresentationRootState = 0x00EF013F;
SetWall_MiscDataAndCode = 0x00F200EF;
WidgetCharMap_DataEntry1 = 0x00EB00D8;
