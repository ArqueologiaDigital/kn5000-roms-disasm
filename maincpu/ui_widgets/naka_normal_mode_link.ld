/* naka_normal_mode_link.ld — Linker script for naka_normal_mode.c
 * Auto-generated by scripts/naka_struct_decode.py
 */

ENTRY(0)

SECTIONS {
    .text : { *(.text*) *(.rodata*) }
    /DISCARD/ : { *(.comment) *(.note*) *(.eh_frame*) }
}

CRTC_LINE_COMPARE = 0x00000018;
LABEL_EC013F = 0x00EC013F;
Naka_PresentationRootState = 0x00EF013F;
