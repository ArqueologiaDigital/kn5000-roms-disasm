/* naka_debug_naming_link.ld — Linker script for naka_debug_naming.c
 * Auto-generated by scripts/naka_struct_decode.py
 */

ENTRY(0)

SECTIONS {
    .text : { *(.text*) *(.rodata*) }
    /DISCARD/ : { *(.comment) *(.note*) *(.eh_frame*) }
}

CheckTitleFunc = 0x00F9800C;
DefMainFunction = 0x00FA4A6A;
DirmdTitleFunc = 0x00F9ADF6;
FDC_CMD_READ_ID = 0x0000000A;
LABEL_E000C3 = 0x00E000C3;
LABEL_E00113 = 0x00E00113;
LABEL_FFFFFF = 0x00FFFFFF;
MainAutoFree = 0x00F98981;
MainBitControl = 0x00F98BD2;
MainGetPmemName = 0x00F99084;
MainGetRhythmName = 0x00F98FE2;
MainGetSoundName = 0x00F98CAE;
MainPmanControl = 0x00F99177;
MainRamControl = 0x00F9898B;
MainTaskControl = 0x00F987E9;
MainTitleControl = 0x00F992F5;
MainTrSwControl = 0x00F99148;
NakaData_StyleBitmaps = 0x00EB71BE;
NakaInst_Param_EndFF = 0x00EE013B;
NakaInst_Param_Val00_01 = 0x00EE0113;
NakaInst_iduMurai = 0x00EB71C8;
Naka_FileManagerEntry = 0x00EB2AE4;
Naka_PresentationRootState = 0x00EF013F;
SendPartDataBlock_Data2 = 0x00FF0000;
SendPartDataBlock_Data5 = 0x00FF00FF;
SeqByteBlock_PathNormalize = 0x00F500D7;
WidgetCharMap_DataEntry1 = 0x00EB00D8;
WidgetName_PtrBlock_G = 0x00EB00A4;
WidgetName_PtrBlock_I1 = 0x00EB00C4;
