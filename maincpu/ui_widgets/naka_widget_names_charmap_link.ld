/* naka_widget_names_charmap_link.ld -- Linker script for naka_widget_names_charmap.c
 * Auto-generated by scripts/convert_naka_to_struct.py
 */

ENTRY(0)

SECTIONS {
    .text : { *(.text*) }
    /DISCARD/ : { *(.comment) *(.note*) *(.eh_frame*) }
}

