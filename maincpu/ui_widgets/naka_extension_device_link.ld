/* naka_extension_device_link.ld — Linker script for naka_extension_device.c
 * Auto-generated by scripts/naka_struct_decode.py
 */

ENTRY(0)

SECTIONS {
    .text : { *(.text*) *(.rodata*) }
    /DISCARD/ : { *(.comment) *(.note*) *(.eh_frame*) }
}

Audio_CopyStateFromROM = 0x00FC6972;
Audio_NullHandler_A = 0x00FC6994;
Audio_NullHandler_B = 0x00FC6995;
Audio_NullHandler_C = 0x00FC6996;
DataBuf_Data_FormatDispatch = 0x00FD5304;
Encoder_AlignByte = 0x00FC5760;
Encoder_MarkInvalid = 0x00FC5757;
Encoder_PassthroughIdentity = 0x00FC6DE9;
Encoder_ProcessBreath = 0x00FC6D2D;
Encoder_ProcessExpression = 0x00FC6DC9;
Encoder_ProcessFoot = 0x00FC6D9F;
Encoder_ProcessModwheel = 0x00FC6C80;
Encoder_ProcessVolume = 0x00FC6CAE;
Encoder_ReturnDefaultConstant = 0x00FC6DEE;
Encoder_Stub1 = 0x00FC575D;
Encoder_Stub2 = 0x00FC575E;
Encoder_Stub3 = 0x00FC575F;
ErrorDialog_CPUTransmissionError = 0x00ED66C4;
ErrorDialog_CautionHeader = 0x00ED669A;
ErrorDialog_RecoveryLine1 = 0x00ED670A;
ErrorDialog_RecoveryLine2 = 0x00ED6750;
ErrorDialog_RecoveryLine3 = 0x00ED6790;
ExtData_ChordTypeTable_Top = 0x00ED0008;
ExtDev_SndParam_Block14_Dual = 0x00FC670E;
ExtDev_SndParam_Block48_Var02 = 0x00FC676B;
ExtDev_SndParam_Block48_Var04 = 0x00FC659E;
ExtDev_SndParam_Block48_Var04_B = 0x00FC65C3;
ExtDev_SndParam_Block48_Var40 = 0x00FC6554;
ExtDev_SndParam_Block48_Var80 = 0x00FC6579;
ExtDev_SndParam_Block70_Var04 = 0x00FC6797;
ExtDev_SndParam_Block98_Var40 = 0x00FC6625;
ExtDev_SndParam_Block98_Var40_B = 0x00FC669C;
ExtDev_SndParam_Block98_Var80 = 0x00FC6677;
ExtDev_SndParam_BlockA9_Var02 = 0x00FC664A;
ExtDev_SndParam_ConfigAndWrite = 0x00FC66C1;
ExtDev_SndParam_DispatchAndWriteA8 = 0x00FC67BC;
ExtDev_SndParam_DispatchAndWriteA8_Alt = 0x00FC6815;
ExtDev_SndParam_DispatchComplex = 0x00FC688C;
ExtDev_SndParam_MultiReg_Iterate = 0x00FC686E;
ExtDev_SndParam_Write48_Block = 0x00FC6732;
ExtDev_SndParam_Write98_Block = 0x00FC65E8;
FileIO_BytecodeData = 0x00FC5874;
LABEL_E00302 = 0x00E00302;
LABEL_E41807 = 0x00E41807;
LABEL_FC645A = 0x00FC645A;
LABEL_FC647F = 0x00FC647F;
LABEL_FC64EA = 0x00FC64EA;
Naka_PresentationRootState = 0x00EF013F;
