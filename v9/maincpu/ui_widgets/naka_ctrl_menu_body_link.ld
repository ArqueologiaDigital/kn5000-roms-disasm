/* naka_ctrl_menu_body_link.ld — Linker script for naka_ctrl_menu_body.c
 * Auto-generated by scripts/naka_struct_decode.py
 */

ENTRY(0)

SECTIONS {
    .text : { *(.text*) *(.rodata*) }
    /DISCARD/ : { *(.comment) *(.note*) *(.eh_frame*) }
}

CRTC_LINE_COMPARE = 0x00000018;
FDC_CMD_READ_ID = 0x0000000A;
NakaStr_CtrlParam9e9 = 0x00ED013B;
NakaInst_RHYTHM_SELECT_TEMPO_APC_MEMORY_SPLIT_POINT = 0x00EF0130;
NakaState_ZeroBlock_3 = 0x00EF0117;
NakaState_ZeroBlock_4 = 0x00EF013B;
Naka_PresentationRootState = 0x00EF013F;
PlySngSel2Func = 0x00F30017;
SeqByteBlock_EffectsSeqData = 0x00F5008B;
SeqByteBlock_EffectsSeqDotExt = 0x00F500B5;
SeqByteBlock_EffectsSeqEntry = 0x00F5008F;
SeqByteBlock_TechnichordCfgA = 0x00F500D6;
WidgetCharMap_DataEntry1 = 0x00EB00D8;
