/* naka_technichord_part_link.ld — Linker script for naka_technichord_part.c
 * Auto-generated by scripts/naka_struct_decode.py
 */

ENTRY(0)

SECTIONS {
    .text : { *(.text*) *(.rodata*) }
    /DISCARD/ : { *(.comment) *(.note*) *(.eh_frame*) }
}

CRTC_LINE_COMPARE = 0x00000018;
FDC_CMD_READ_ID = 0x0000000A;
NakaData_DescriptorPad1 = 0x00E60008;
NakaData_Tables2Pad3 = 0x00E700DE;
NakaData_TechnichordBitmap2 = 0x00E9013D;
NakaStr_SoundPreset176 = 0x00EC00C7;
NakaData_PerfStyleCode = 0x00F5001F;
LED_patterns_firmware_v8_plus = 0x00E00008;
NAKA_TYPE_0x5D = 0x0000005D;
NAKA_TYPE_0x61 = 0x00000061;
NakaContainer_SoundMenu_Root = 0x00E818B0;
NakaData_ModeConfig1 = 0x00E80008;
NakaInst_NEXT = 0x00EE00C3;
NakaInst_Param_EndFF = 0x00EE013B;
NakaInst_Param_Repeat = 0x00EE009B;
NakaInst_Param_Val00_01 = 0x00EE0113;
NakaMenuItem_AcousticIllusion = 0x00E81BAA;
NakaMenuItem_DspEffect = 0x00E81B68;
NakaMenuItem_Equalizer = 0x00E81B28;
NakaMenuItem_KeyScaling = 0x00E81A5E;
NakaMenuItem_LeftHold = 0x00E81C58;
NakaMenuItem_MasterTuning = 0x00E81A1A;
NakaMenuItem_Mixer = 0x00E819DE;
NakaMenuItem_PartSetting = 0x00E8199A;
NakaMenuItem_Reverb = 0x00E81AEA;
NakaMenuItem_ReverbEqPresets = 0x00E81AA0;
NakaMenuItem_TechniChord = 0x00E81C98;
NakaState_ZeroBlock_3 = 0x00EF0117;
NakaState_ZeroBlock_4 = 0x00EF013B;
NakaWidget_SoundEdit = 0x00E81BF2;
NakaWidget_SoundMenu_ListBox = 0x00E81942;
NakaWidget_SoundMenu_PageButton = 0x00E818E6;
NakaWidget_SoundMenu_PageControl = 0x00E81976;
NakaWidget_SoundMenu_PageControl2 = 0x00E81C34;
NakaWidget_SoundMenu_ScrollBar1 = 0x00E8190A;
NakaWidget_SoundMenu_ScrollBar2 = 0x00E81926;
NakaWidget_SoundMenu_ValueEdit = 0x00E8195C;
Naka_Help_564_E300C7 = 0x00E300C7;
Naka_PresentationRootState = 0x00EF013F;
PCFC = 0x00000033;
PDFC = 0x00000037;
PlySngSel2Func = 0x00F30017;
Presentation_TagStrTable = 0x00EA0008;
SCREEN_BPP = 0x00000008;
SeqByteBlock_EffectsSeqData = 0x00F5008B;
SeqByteBlock_EffectsSeqDotExt = 0x00F500B5;
SeqByteBlock_TechnichordCfgA = 0x00F500D6;
SeqByteBlock_TechnichordCfgB = 0x00F500E9;
WidgetCharMap_DataEntry1 = 0x00EB00D8;
WidgetName_PtrBlock_H = 0x00EB00B8;
