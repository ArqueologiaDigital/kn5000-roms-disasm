/* naka_sound_menu_drawbar_link.ld — Linker script for naka_sound_menu_drawbar.c
 * Auto-generated by scripts/naka_struct_decode.py
 */

ENTRY(0)

SECTIONS {
    .text : { *(.text*) *(.rodata*) }
    /DISCARD/ : { *(.comment) *(.note*) *(.eh_frame*) }
}

AcAccordionTabProc = 0x00F7E6D6;
AcDrawEditBoxProc = 0x00F82EED;
AcDrawSettingProc = 0x00F82A5E;
AcDrawbarNameProc = 0x00F82B06;
AcFdemoScreenProc = 0x00F84149;
AcLswPartEditBoxProc = 0x00F7BB6F;
AcLswPartPanProc = 0x00F7C80E;
AcPartMixerProc = 0x00F80739;
AcPleaseWaitProc = 0x00F7DE48;
AcPresentationBoxProc = 0x00F842B4;
AcPresentationControlProc = 0x00F8450B;
AcResetPageProc = 0x00F8086B;
AcSndEMenuProc = 0x00F7B665;
AcTrackMixerProc = 0x00F8077F;
AcVolPartEditBoxProc = 0x00F7C09E;
AcWelcomScreenProc = 0x00F7F4A6;
IvAccordionProc = 0x00F7E250;
IvAccordionXProc = 0x00F7E654;
IvDemofeature1Proc = 0x00F841EE;
IvDemofeature2Proc = 0x00F8422F;
IvDrawbar1Proc = 0x00F8334F;
IvDrawbar2Proc = 0x00F837E8;
IvDrawbarNormProc = 0x00F839E5;
IvDrawbarProc = 0x00F824C4;
IvDrawbarSndEProc = 0x00F83B51;
IvMPverProc = 0x00F7F422;
IvMesageProc = 0x00F7DD23;
IvPageOverWriteProc = 0x00F82DDE;
IvSdpartProc = 0x00F7B725;
IvSdscltyp2Proc = 0x00F7EECF;
IvSdtecd1Proc = 0x00F7E8A1;
IvSdtecdProc = 0x00F7E7DB;
IvSoftverProc = 0x00F7F328;
Naka_PresentationRootState = 0x00EF013F;
PsLabelBoxProc = 0x00F7EB2D;
PsMixerControlProc = 0x00F7FA5A;
PsVariBoxProc = 0x00F83E7D;
VwUserBitmapSpProc = 0x00F840CC;
