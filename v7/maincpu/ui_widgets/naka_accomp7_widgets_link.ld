/* naka_accomp7_widgets_link.ld — Linker script for naka_accomp7_widgets.c
 * Auto-generated by scripts/naka_struct_decode.py
 */

ENTRY(0)

SECTIONS {
    .text : { *(.text*) *(.rodata*) }
    /DISCARD/ : { *(.comment) *(.note*) *(.eh_frame*) }
}

Naka_PresentationRootState = 0x00EF013F;
PlySngSel2Func = 0x00F30017;
