/* naka_debug_naming_link.ld — Linker script for naka_debug_naming.c
 * Auto-generated by scripts/naka_struct_decode.py
  * v7 addresses where v7's own bytes agree:
 * scripts/generators/generate_v7_naka_link_scripts.py
 */

ENTRY(0)

SECTIONS {
    .text : { *(.text*) *(.rodata*) }
    /DISCARD/ : { *(.comment) *(.note*) *(.eh_frame*) }
}

CheckTitleFunc = 0x00F97BFF;
DefMainFunction = 0x00FA465D;
DirmdTitleFunc = 0x00F9A9E9;
FDC_CMD_READ_ID = 0x0000000A;
NakaStr_DataFile1of2 = 0x00E000C3;
NakaStr_DataFilePck = 0x00E00113;
NakaData_RomEnd = 0x00FFFFFF;
MainAutoFree = 0x00F98574;
MainBitControl = 0x00F987C5;
MainGetPmemName = 0x00F98C77;
MainGetRhythmName = 0x00F98BD5;
MainGetSoundName = 0x00F988A1;
MainPmanControl = 0x00F98D6A;
MainRamControl = 0x00F9857E;
MainTaskControl = 0x00F983DC;
MainTitleControl = 0x00F98EE8;
MainTrSwControl = 0x00F98D3B;
NakaData_StyleBitmaps = 0x00EB71BE;
NakaInst_Param_EndFF = 0x00EE013B;
NakaInst_Param_Val00_01 = 0x00EE0113;
NakaInst_iduMurai = 0x00EB71C8;
NakaDbg_PanelSimBitmap = 0x00EB2AE4;
Naka_PresentationRootState = 0x00EF013F;
SeqByteBlock_PathNormalize = 0x00F500D7;
WidgetCharMap_DataEntry1 = 0x00EB00D8;
WidgetName_PtrBlock_G = 0x00EB00A4;
WidgetName_PtrBlock_I1 = 0x00EB00C4;
NakaInst_iduRoot = 0x00EB71D2;
