/* naka_sound_menu_drawbar_link.ld — Linker script for naka_sound_menu_drawbar.c
 * Auto-generated by scripts/naka_struct_decode.py
  * v7 addresses where v7's own bytes agree:
 * scripts/generators/generate_v7_naka_link_scripts.py
 */

ENTRY(0)

SECTIONS {
    .text : { *(.text*) *(.rodata*) }
    /DISCARD/ : { *(.comment) *(.note*) *(.eh_frame*) }
}

AcAccordionTabProc = 0x00F7E2D2;
AcDrawEditBoxProc = 0x00F82AE9;
AcDrawSettingProc = 0x00F8265A;
AcDrawbarNameProc = 0x00F82702;
AcFdemoScreenProc = 0x00F83D45;
AcLswPartEditBoxProc = 0x00F7B76B;
AcLswPartPanProc = 0x00F7C40A;
AcPartMixerProc = 0x00F80335;
AcPleaseWaitProc = 0x00F7DA44;
AcPresentationBoxProc = 0x00F83EB0;
AcPresentationControlProc = 0x00F84107;
AcResetPageProc = 0x00F80467;
AcSndEMenuProc = 0x00F7B261;
AcTrackMixerProc = 0x00F8037B;
AcVolPartEditBoxProc = 0x00F7BC9A;
AcWelcomScreenProc = 0x00F7F0A2;
IvAccordionProc = 0x00F7DE4C;
IvAccordionXProc = 0x00F7E250;
IvDemofeature1Proc = 0x00F83DEA;
IvDemofeature2Proc = 0x00F83E2B;
IvDrawbar1Proc = 0x00F82F4B;
IvDrawbar2Proc = 0x00F833E4;
IvDrawbarNormProc = 0x00F835E1;
IvDrawbarProc = 0x00F820C0;
IvDrawbarSndEProc = 0x00F8374D;
IvMPverProc = 0x00F7F01E;
IvMesageProc = 0x00F7D91F;
IvPageOverWriteProc = 0x00F829DA;
IvSdpartProc = 0x00F7B321;
IvSdscltyp2Proc = 0x00F7EACB;
IvSdtecd1Proc = 0x00F7E49D;
IvSdtecdProc = 0x00F7E3D7;
IvSoftverProc = 0x00F7EF24;
Naka_PresentationRootState = 0x00EF013F;
PsLabelBoxProc = 0x00F7E729;
PsMixerControlProc = 0x00F7F656;
PsVariBoxProc = 0x00F83A79;
VwUserBitmapSpProc = 0x00F83CC8;
