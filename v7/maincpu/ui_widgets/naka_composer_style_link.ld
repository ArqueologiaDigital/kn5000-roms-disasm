/* naka_composer_style_link.ld — Linker script for naka_composer_style.c
 * Auto-generated by scripts/naka_struct_decode.py
 */

ENTRY(0)

SECTIONS {
    .text : { *(.text*) *(.rodata*) }
    /DISCARD/ : { *(.comment) *(.note*) *(.eh_frame*) }
}

CPANEL_CMD_INIT_CONFIGURE = 0x0000001F;
CRTC_LINE_COMPARE = 0x00000018;
NakaInst_BASS_ACCOMP1_ACCOMP2_ACCOMP3 = 0x00EF012B;
NakaInst_NEXT = 0x00EE00C3;
NakaInst_Param_EndFF = 0x00EE013B;
NakaInst_Param_Repeat = 0x00EE009B;
NakaInst_Param_Val0C = 0x00EE0111;
Naka_Help_563_E300C0 = 0x00E300C0;
Naka_PresentationRootState = 0x00EF013F;
PlySngSel2Func = 0x00F30017;
Presentation_TagStrTable = 0x00EA0008;
SendPartDataBlock_Data4 = 0x00FF00C0;
SeqByteBlock_EffectsSeqData = 0x00F5008B;
SeqByteBlock_PathNormalize = 0x00F500D7;
WidgetCharMap_DataEntry1 = 0x00EB00D8;
WidgetName_PtrBlock_A = 0x00EB0008;
WidgetName_PtrBlock_F2 = 0x00EB009F;
WidgetName_PtrBlock_I2 = 0x00EB00C6;
