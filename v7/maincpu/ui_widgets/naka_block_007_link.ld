/* naka_block_007_link.ld — Linker script for naka_block_007.c
 * Auto-generated by scripts/naka_struct_decode.py
  * v7 addresses where v7's own bytes agree:
 * scripts/generators/generate_v7_naka_link_scripts.py
 */

ENTRY(0)

SECTIONS {
    .text : { *(.text*) *(.rodata*) }
    /DISCARD/ : { *(.comment) *(.note*) *(.eh_frame*) }
}

AcCtlMsgGridBoxProc = 0x00F796D8;
AcFadeSetGridBoxProc = 0x00F74E25;
AcGMOnOffBoxProc = 0x00F7430C;
AcInOutGridBoxProc = 0x00F75356;
AcLswFuncBoxProc = 0x00F74988;
AcLswFuncEditBoxProc = 0x00F74BDB;
AcMidiPartGridBoxProc = 0x00F79DF0;
AcParaLoadOptGridBoxProc = 0x00F7685A;
AcPcgOutGridBoxProc = 0x00F76FD6;
AcPmemOutLGridBoxProc = 0x00F77F25;
AcPmemOutRGridBoxProc = 0x00F78278;
AcVocalGridBoxProc = 0x00F7323E;
NakaDesc_OnOffStyle_Table = 0x00E55790;
NakaDesc_PageGridBox1_Table = 0x00E5597E;
NakaDesc_PmanOnOff1_Table = 0x00E557C2;
NakaDesc_PmanOnOff2_Table = 0x00E55806;
ClassProps_AcFadeSetGridBox = 0x00E5584A;
ClassProps_AcGMOnOffBox = 0x00E557BC;
ClassProps_AcInOutGridBox = 0x00E558A2;
ClassProps_AcMidiPartGridBox = 0x00E559B4;
ClassProps_AcParaLoadOptGridBox = 0x00E558CE;
ClassProps_AcPcgOutGridBox = 0x00E558FA;
ClassProps_AcPmemOutLGridBox = 0x00E55926;
ClassProps_AcPmemOutRGridBox = 0x00E55952;
ClassProps_AcVocalGridBox = 0x00E55876;
