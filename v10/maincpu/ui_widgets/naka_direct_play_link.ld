/* naka_direct_play_link.ld — Linker script for naka_direct_play.c
 * Auto-generated by scripts/naka_struct_decode.py
 */

ENTRY(0)

SECTIONS {
    .text : { *(.text*) *(.rodata*) }
    /DISCARD/ : { *(.comment) *(.note*) *(.eh_frame*) }
}

CRTC_LINE_COMPARE = 0x00000018;
INTETC45 = 0x000000EE;
NakaStr_DataFile1of2 = 0x00E000C3;
NakaStr_DataFilePck = 0x00E00113;
NakaStr_Rhythm = 0x00E2405E;
NakaData_TechnichordBitmap1 = 0x00E900D8;
NakaInst_176 = 0x00EC0098;
NakaInst_176_EC00C0 = 0x00EC00C0;
NakaInst_NEXT = 0x00EE00C3;
NakaInst_Param_EndFF = 0x00EE013B;
NakaInst_Param_Val00_01 = 0x00EE0113;
Naka_PresentationRootState = 0x00EF013F;
SeqByteBlock_EffectsSeqData = 0x00F5008B;
SeqByteBlock_EffectsSeqDotExt = 0x00F500B5;
SeqByteBlock_MedleyPlayback = 0x00F50085;
SeqByteBlock_MedleyPlaybackB = 0x00F50093;
SeqByteBlock_PathNormalize = 0x00F500D7;
WidgetCharMap_DataEntry1 = 0x00EB00D8;
WidgetName_PtrBlock_F2 = 0x00EB009F;
WidgetName_PtrBlock_G = 0x00EB00A4;
WidgetName_PtrBlock_I1 = 0x00EB00C4;
WidgetName_PtrBlock_I2 = 0x00EB00C6;
WidgetName_PtrBlock_K = 0x00EB00DB;
