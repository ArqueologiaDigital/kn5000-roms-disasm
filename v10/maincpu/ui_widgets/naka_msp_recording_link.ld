/* naka_msp_recording_link.ld — Linker script for naka_msp_recording.c
 * Auto-generated by scripts/naka_struct_decode.py
 */

ENTRY(0)

SECTIONS {
    .text : { *(.text*) *(.rodata*) }
    /DISCARD/ : { *(.comment) *(.note*) *(.eh_frame*) }
}

NakaInst_Param_EndFF = 0x00EE013B;
Naka_PresentationRootState = 0x00EF013F;
SeqByteBlock_EffectsSeqData = 0x00F5008B;
SeqByteBlock_EffectsSeqDotExt = 0x00F500B5;
NakaWidget_CmpMeas = 0x00E190EA;
NakaWidget_CmpMem = 0x00E18CBC;
NakaWidget_CmpQtz = 0x00E190C6;
NakaWidget_CmpRealScreen = 0x00E18C64;
NakaWidget_CmpRealScreen_10_VwEditSwBox = 0x00E18DEE;
NakaWidget_CmpRealScreen_11_VwEditSwBox = 0x00E18E1E;
NakaWidget_CmpRealScreen_12_VwEditSwBox = 0x00E18E4E;
NakaWidget_CmpRealScreen_13_VwEditSwBox = 0x00E18E7E;
NakaWidget_CmpRealScreen_14_VwEditSwBox = 0x00E18EAE;
NakaWidget_CmpRealScreen_15_AcCmpTempoBox = 0x00E18EDE;
NakaWidget_CmpRealScreen_16_AcTitleMenu = 0x00E18F02;
NakaWidget_CmpRealScreen_17_AcTitleMenu = 0x00E18F3C;
NakaWidget_CmpRealScreen_18_AcMemNoBox = 0x00E18F78;
NakaWidget_CmpRealScreen_19_VwMenuBox = 0x00E18F9C;
NakaWidget_CmpRealScreen_1_Box = 0x00E18CA2;
NakaWidget_CmpRealScreen_20_VwMenuBox = 0x00E18FD8;
NakaWidget_CmpRealScreen_21_VwMenuBox = 0x00E19014;
NakaWidget_CmpRealScreen_22_VwMenuBox = 0x00E19050;
NakaWidget_CmpRealScreen_23_VwMenuBox = 0x00E1908C;
NakaWidget_CmpRealScreen_3_Label = 0x00E18CE0;
NakaWidget_CmpRealScreen_4_Label = 0x00E18D02;
NakaWidget_CmpRealScreen_5_Label = 0x00E18D2C;
NakaWidget_CmpRealScreen_6_Label = 0x00E18D56;
NakaWidget_CmpRealScreen_7_Label = 0x00E18D80;
NakaWidget_CmpRealScreen_8_Label = 0x00E18DAA;
NakaWidget_CmpRealScreen_9_IvMainEditSw = 0x00E18DD4;
