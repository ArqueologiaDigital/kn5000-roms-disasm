/* naka_midi_reverb_link.ld — Linker script for naka_midi_reverb.c
 * Auto-generated by scripts/naka_struct_decode.py
 */

ENTRY(0)

SECTIONS {
    .text : { *(.text*) *(.rodata*) }
    /DISCARD/ : { *(.comment) *(.note*) *(.eh_frame*) }
}

NakaInst_Param_EndFF = 0x00EE013B;
NakaInst_Param_Repeat = 0x00EE009B;
NakaInst_Param_Val00_01 = 0x00EE0113;
NakaInst_Param_Val02 = 0x00EE00D8;
NakaInst_SequencerComboBox = 0x00E90130;
Naka_PresentationRootState = 0x00EF013F;
PDFC = 0x00000037;
PlySngSel2Func = 0x00F30017;
SeqByteBlock_EffectsSeqData = 0x00F5008B;
SeqByteBlock_EffectsSeqDotExt = 0x00F500B5;
WidgetCharMap_DataEntry1 = 0x00EB00D8;
WidgetCharMap_DataEntry2 = 0x00EB013F;
